## boards/shields/custom_kb/Kconfig.defconfig
```kconfig
if SHIELD_CUSTOM_KB_R

config ZMK_KEYBOARD_NAME
    default "custom_kb_R"

config ZMK_SPLIT
    default y

config ZMK_SPLIT_ROLE_CENTRAL
    default y

endif

if SHIELD_CUSTOM_KB_L

config ZMK_KEYBOARD_NAME
    default "custom_kb_L"

config ZMK_SPLIT
    default y

endif
```

## boards/shields/custom_kb/Kconfig.shield
```kconfig
config SHIELD_CUSTOM_KB_R
    def_bool $(shields_list_contains,custom_kb_R)

config SHIELD_CUSTOM_KB_L
    def_bool $(shields_list_contains,custom_kb_L)
```
